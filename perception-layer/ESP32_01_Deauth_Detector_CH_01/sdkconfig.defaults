## perception-layer/ESP32_01_Deauth_Detector_CH_01/sdkconfig.defaults
```kconfig
# BLE básico
CONFIG_BT_ENABLED=y
CONFIG_BT_BLE_ENABLED=y
CONFIG_BT_BLUEDROID_ENABLED=y
CONFIG_BT_CONTROLLER_ENABLED=y
CONFIG_BTDM_CONTROLLER_MODE_BLE_ONLY=y

# Seguridad BLE
CONFIG_BT_BLE_SECURE_CONN=y
CONFIG_BT_BLE_SMP_ENABLE=y
CONFIG_BT_SMP_ENABLE=y

# Longitud de clave BLE
CONFIG_BT_BLE_MAX_ENCRYPTION_KEY_SIZE=16

# Particiones personalizadas
CONFIG_PARTITION_TABLE_CUSTOM=y
CONFIG_PARTITION_TABLE_CUSTOM_FILENAME="../partitions.csv"
CONFIG_PARTITION_TABLE_FILENAME="../partitions.csv"
```
